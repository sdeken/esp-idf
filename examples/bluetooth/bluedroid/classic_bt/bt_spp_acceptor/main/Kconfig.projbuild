## examples/bluetooth/bluedroid/classic_bt/bt_spp_acceptor/main/Kconfig.projbuild
```kconfig
menu "SPP Example Configuration"
    config EXAMPLE_SSP_ENABLED
        bool "Secure Simple Pairing"
        depends on BT_CLASSIC_ENABLED
        default n
        help
            This enables the Secure Simple Pairing. If disable this option,
            Bluedroid will only support Legacy Pairing. Note: disabling SSP
            is only recommended for testing/demonstration purposes.

    config EXAMPLE_LOCAL_DEVICE_NAME
        string "Local Device Name"
        default "ESP_SPP_ACCEPTOR"
        help
            Use this option to set local device name.
endmenu
```
